## arch/arm64/hotplug/INTELLIPLUG/Kconfig
```kconfig
config INTELLI_PLUG
	   bool "Hotplug for Razor Reborn"
	   depends on MSM_RUN_QUEUE_STATS
	   default y
	   help
		 This enables kernel based multi core control. Best Choice for Razor Reborn
```

## kernel/events/Kconfig
```kconfig
config NOHAMMER
        tristate "Rowhammer protection"
        help
	  Enable rowhammer attack prevention. Will degrade system
	  performance under attack so much that attack should not
	  be feasible.

	  To compile this driver as a module, choose M here: the
	  module will be called nohammer.
```
